## config/west.yml
```yaml
manifest:
  remotes:
    - name: zmkfirmware
      url-base: https://github.com/zmkfirmware
    - name: inorichi
      url-base: https://github.com/inorichi
    - name: keyfreaks
      url-base: https://github.com/kay-yokoyama
    - name: caksoylar
      url-base: https://github.com/caksoylar
    - name: oleksandrmaslov  # <-- Pointer acceleration
      url-base: https://github.com/oleksandrmaslov
  projects:
    - name: zmk
      remote: zmkfirmware
      revision: v0.2.1
      import: app/west.yml
    - name: zmk-pmw3610-driver
      remote: inorichi
      revision: main
    - name: zmk-rgbled-widget
      remote: caksoylar
      revision: v0.3-branch
    - name: zmk-pointing-acceleration
      remote: oleksandrmaslov
      revision: main
  self:
    path: config
```
